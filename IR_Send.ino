int On1Signal[] = {8996,-4456,604,-500,604,-492,612,-1596,612,-1592,612,-1596,612,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616,0};
int On2Signal[] = {8992,-4448,616,-496,608,-504,612,-1596,616,-1588,624,-1588,616,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604,0};
 
void setup() {
}
void loop() {
  IRsend(40,On1Signal);
  delay(1000);
  IRsend(40,On2Signal);
  delay(1000);
}
 
void IRsend(int IRpin, int IRsignal[]) {
  int i=0;
  pinMode(IRpin, OUTPUT);
  do {
    if (IRsignal[i] > 0) {
      int duration = IRsignal[i];
      while (duration > 0) {
        digitalWrite(IRpin, HIGH);
        delayMicroseconds(10);
        digitalWrite(IRpin, LOW);
        delayMicroseconds(10);
        duration -= 26;         // 38 kHz = 26.3 uSec
      }
    }
    else {
      delayMicroseconds(abs(IRsignal[i]));
    }
    i+=1;
  }
  while (IRsignal[i] != 0);
}
